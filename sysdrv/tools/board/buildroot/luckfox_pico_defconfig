## sysdrv/tools/board/buildroot/luckfox_pico_defconfig
```kconfig
BR2_arm=y
BR2_cortex_a7=y
BR2_TOOLCHAIN_EXTERNAL=y
BR2_TOOLCHAIN_EXTERNAL_CUSTOM=y
BR2_TOOLCHAIN_EXTERNAL_PATH="../../../../tools/linux/toolchain/arm-rockchip830-linux-uclibcgnueabihf"
BR2_TOOLCHAIN_EXTERNAL_CUSTOM_PREFIX="arm-rockchip830-linux-uclibcgnueabihf"
BR2_TOOLCHAIN_EXTERNAL_GCC_8=y
BR2_TOOLCHAIN_EXTERNAL_HEADERS_5_10=y
BR2_TOOLCHAIN_EXTERNAL_WCHAR=y
BR2_TOOLCHAIN_EXTERNAL_HAS_SSP=y
BR2_TOOLCHAIN_EXTERNAL_CXX=y
BR2_PRIMARY_SITE="http://sources.buildroot.net"
BR2_OPTIMIZE_3=y
BR2_TARGET_GENERIC_HOSTNAME="luckfox pico - drone"
BR2_TARGET_GENERIC_ISSUE="Welcome to luckfox pico drone"
BR2_TARGET_GENERIC_ROOT_PASSWD="333"
BR2_SYSTEM_ENABLE_NLS=y
BR2_PACKAGE_BUSYBOX_SHOW_OTHERS=y
BR2_PACKAGE_E2FSPROGS=y
BR2_PACKAGE_E2FSPROGS_RESIZE2FS=y
BR2_PACKAGE_EVTEST=y
BR2_PACKAGE_PYTHON3=y
BR2_PACKAGE_PYTHON3_SSL=y
BR2_PACKAGE_PYTHON_AIOHTTP=y
BR2_PACKAGE_PYTHON_CLICK=y
BR2_PACKAGE_PYTHON_ITSDANGEROUS=y
BR2_PACKAGE_PYTHON_JINJA2=y
BR2_PACKAGE_PYTHON_PERIPHERY=y
BR2_PACKAGE_PYTHON_PIP=y
BR2_PACKAGE_PYTHON_PILLOW=y
BR2_PACKAGE_PYTHON_SMBUS2=y
BR2_PACKAGE_PYTHON_SERIAL=y
BR2_PACKAGE_PYTHON_SETUPTOOLS=y
BR2_PACKAGE_PYTHON_SMBUS_CFFI=y
BR2_PACKAGE_PYTHON_SPIDEV=y
BR2_PACKAGE_PYTHON_WERKZEUG=y
BR2_PACKAGE_GNUTLS=y
BR2_PACKAGE_LIBMD=y
BR2_PACKAGE_FREETYPE=y
BR2_PACKAGE_LIBDRM=y
BR2_PACKAGE_DTC=y
BR2_PACKAGE_DTC_PROGRAMS=y
BR2_PACKAGE_LIBV4L=y
BR2_PACKAGE_LIBV4L_UTILS=y
BR2_PACKAGE_LIBRSYNC=y
BR2_PACKAGE_PCRE2=y
BR2_PACKAGE_PCRE2_16=y
BR2_PACKAGE_PCRE2_32=y
BR2_PACKAGE_IPERF=y
BR2_PACKAGE_IPERF3=y
BR2_PACKAGE_LRZSZ=y
BR2_PACKAGE_NTP=y
BR2_PACKAGE_OPENSSH=y
BR2_PACKAGE_RSYNC=y
BR2_PACKAGE_SOCAT=y
BR2_PACKAGE_BASH=y
BR2_PACKAGE_BASH_LOADABLE_EXAMPLES=y
BR2_PACKAGE_DIALOG=y
BR2_PACKAGE_TIME=y
BR2_PACKAGE_HTOP=y
BR2_PACKAGE_UTIL_LINUX_LIBMOUNT=y
BR2_PACKAGE_NANO=y
BR2_PACKAGE_HOST_DTC=y
BR2_PACKAGE_WIREGUARD_TOOLS=y

BR2_PACKAGE_MC=y

BR2_PACKAGE_FFMPEG_ARCH_SUPPORTS=y
BR2_PACKAGE_FFMPEG=y
# BR2_PACKAGE_FFMPEG_GPL is not set
# BR2_PACKAGE_FFMPEG_NONFREE is not set
BR2_PACKAGE_FFMPEG_FFMPEG=y
# BR2_PACKAGE_FFMPEG_FFPLAY is not set
# BR2_PACKAGE_FFMPEG_FFPROBE is not set
# BR2_PACKAGE_FFMPEG_SWSCALE is not set
BR2_PACKAGE_FFMPEG_ENCODERS="all"
BR2_PACKAGE_FFMPEG_DECODERS="all"
BR2_PACKAGE_FFMPEG_MUXERS="all"
BR2_PACKAGE_FFMPEG_DEMUXERS="all"
BR2_PACKAGE_FFMPEG_PARSERS="all"
BR2_PACKAGE_FFMPEG_BSFS="all"
BR2_PACKAGE_FFMPEG_PROTOCOLS="all"
BR2_PACKAGE_FFMPEG_FILTERS="all"
BR2_PACKAGE_FFMPEG_INDEVS=y
BR2_PACKAGE_FFMPEG_OUTDEVS=y
BR2_PACKAGE_FFMPEG_EXTRACONF=""



BR2_PACKAGE_IPTABLES=y

BR2_PACKAGE_GO2RTC=y

#BR2_PACKAGE_AVAHI=y
#BR2_PACKAGE_AVAHI_DAEMON=y
#BR2_PACKAGE_AVAHI_DEFAULT_SERVICES=y
BR2_PACKAGE_NETCAT=y
BR2_PACKAGE_TCPDUMP=y

BR2_PACKAGE_ALSA_LIB=y
BR2_PACKAGE_IPERF3=y
BR2_PACKAGE_ETHTOOL=y
BR2_PACKAGE_ETHTOOL_PRETTY_PRINT=y
BR2_PACKAGE_IPROUTE2=y
BR2_PACKAGE_MTR=y
BR2_PACKAGE_IFTOP=y
BR2_PACKAGE_PHYTOOL=y
BR2_PACKAGE_TCPDUMP=y
BR2_PACKAGE_BMON=y
BR2_PACKAGE_FPING=y
BR2_PACKAGE_NLOAD=y
BR2_PACKAGE_IPUTILS=y
BR2_PACKAGE_IPUTILS_ARPING=y
BR2_PACKAGE_IPUTILS_PING=y
BR2_PACKAGE_IPUTILS_TRACEPATH=y

# Try B.A.T.M.A.N.
BR2_PACKAGE_BATCTL=y
#BR2_PACKAGE_BATMAN_ADV=y


# Alternatives for go2rtc
BR2_PACKAGE_LIVE555=y

# GStreamer (look to OpenHD project for reference)
BR2_PACKAGE_LIBSODIUM=y
BR2_PACKAGE_GSTREAMER1=y
BR2_PACKAGE_GST1_PLUGINS_BASE=y
BR2_PACKAGE_GST1_PLUGINS_BASE_PLUGIN_APP=y


BR2_PACKAGE_GST1_PLUGINS_GOOD=y
BR2_PACKAGE_GST1_PLUGINS_BAD=y
BR2_PACKAGE_GST1_PLUGINS_UGLY=y
BR2_PACKAGE_GST1_DEVTOOLS=y
BR2_PACKAGE_GSTREAMER_ROCKCHIP_MPP=y

BR2_PACKAGE_GST1_PLUGINS_BAD_PLUGIN_VIDEOPARSERS=y

BR2_PACKAGE_GST1_PLUGINS_BASE_PLUGIN_TCP=y
BR2_PACKAGE_GST1_PLUGINS_BASE_PLUGIN_VIDEOTESTSRC=y
BR2_PACKAGE_GST1_PLUGINS_BASE_PLUGIN_VIDEORATE=y

BR2_PACKAGE_GST1_PLUGINS_GOOD_PLUGIN_RTP=y
BR2_PACKAGE_GST1_PLUGINS_GOOD_PLUGIN_RTSP=y
BR2_PACKAGE_GST1_PLUGINS_GOOD_PLUGIN_RTPMANAGER=y
BR2_PACKAGE_GST1_PLUGINS_GOOD_PLUGIN_UDP=y
BR2_PACKAGE_GST1_PLUGINS_GOOD_PLUGIN_MATROSKA=y

# OpenHD itself. Not sure if is will be copied to output image automatically.
#BR2_PACKAGE_OPENHD=y
BR2_PACKAGE_POCO=y
BR2_PACKAGE_EXPAT=y
BR2_PACKAGE_POCO_NET=y
BR2_PACKAGE_LIBPCAP=y
BR2_PACKAGE_IW=y

# Try this too
BR2_PACKAGE_GST1_PLUGINS_BAD_PLUGIN_WEBRTC=y

# BR2_PACKAGE_GST1_PLUGINS_GOOD=y
# BR2_PACKAGE_GST1_PLUGINS_BAD=y
# BR2_PACKAGE_GST1_PLUGINS_UGLY=y
# BR2_PACKAGE_GST1_DEVTOOLS=y
# BR2_PACKAGE_GSTREAMER_ROCKCHIP_MPP=y

# BR2_PACKAGE_GST1_PLUGINS_BASE_PLUGIN_TCP=y
# BR2_PACKAGE_GST1_PLUGINS_BASE_PLUGIN_VIDEOTESTSRC=y
# BR2_PACKAGE_GST1_PLUGINS_BASE_PLUGIN_VIDEORATE=y

# BR2_PACKAGE_GST1_PLUGINS_GOOD_PLUGIN_RTP=y
# BR2_PACKAGE_GST1_PLUGINS_GOOD_PLUGIN_RTSP=y
# BR2_PACKAGE_GST1_PLUGINS_GOOD_PLUGIN_RTPMANAGER=y
# BR2_PACKAGE_GST1_PLUGINS_GOOD_PLUGIN_UDP=y
# BR2_PACKAGE_GST1_PLUGINS_GOOD_PLUGIN_MATROSKA=y

# BR2_PACKAGE_GST1_PLUGINS_GOOD_PLUGIN_V4L2=y
# BR2_PACKAGE_GST1_PLUGINS_GOOD_JPEG=y
# BR2_PACKAGE_GST1_PLUGINS_GOOD_PLUGIN_DEBUGUTILS=y
# BR2_PACKAGE_GST1_PLUGINS_GOOD_PLUGIN_AUTODETECT=y
# BR2_PACKAGE_GST1_PLUGINS_GOOD_PLUGIN_MULTIPART=y
# BR2_PACKAGE_GST1_PLUGINS_GOOD_PLUGIN_VIDEOCROP=y
# BR2_PACKAGE_GST1_PLUGINS_GOOD_PLUGIN_MULTIFILE=y
# BR2_PACKAGE_GST1_PLUGINS_GOOD_PLUGIN_FLV=y

# BR2_PACKAGE_GST1_PLUGINS_BAD_PLUGIN_VIDEOPARSERS=y
# BR2_PACKAGE_GST1_PLUGINS_BAD_PLUGIN_MPEGTSMUX=y
# #BR2_PACKAGE_GST1_PLUGINS_BAD_PLUGIN_WEBRTC=y
# BR2_PACKAGE_GST1_PLUGINS_BAD_PLUGIN_RTMP=y
# BR2_PACKAGE_GST1_PLUGINS_BAD_PLUGIN_DEBUGUTILS=y
# BR2_PACKAGE_GST1_PLUGINS_BAD_PLUGIN_SHM=y
# BR2_PACKAGE_GST1_PLUGINS_BAD_PLUGIN_AUTOCONVERT=y

# BR2_PACKAGE_GST1_PLUGINS_UGLY_PLUGIN_X264=y
BR2_PACKAGE_I2C_TOOLS=y

BR2_PACKAGE_LIBCURL=y
BR2_PACKAGE_LIBCURL_CURL=y
BR2_PACKAGE_LIBCURL_WEBSOCKETS_SUPPORT=y
BR2_PACKAGE_LIBCURL_EXTRA_PROTOCOLS_FEATURES=y
BR2_PACKAGE_LIBUEV=y
BR2_PACKAGE_LIBUHTTPD=y
BR2_PACKAGE_LIBPJSIP=y
BR2_PACKAGE_LIBOPING=y
BR2_PACKAGE_LIBUWSC=y
BR2_PACKAGE_LIBWEBSOCKETS=y
BR2_PACKAGE_LIBWEBSOCKETS_EXT_POLL=y

# Long way to Rust Drone App
#BR2_PACKAGE_HOST_RUSTC=y
```

## sysdrv/tools/board/buildroot/package/go2rtc/Config.in
```kconfig
config BR2_PACKAGE_GO2RTC
	bool "go2rtc"
	depends on BR2_PACKAGE_HOST_GO_TARGET_ARCH_SUPPORTS
	select BR2_PACKAGE_HOST_GO
	help
	  Ultimate camera streaming server with support of
	  RTSP, RTMP, HTTP-FLV, WebRTC, MSE, HLS, MP4, JPEG.

	  https://github.com/AlexxIT/go2rtc
```
